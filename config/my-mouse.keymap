#include <behaviors.dtsi>
#include <dt-bindings/zmk/keys.h>

/ {
    keymap {
        compatible = "zmk,keymap";
        default_layer {
            bindings = <
                &kp A    // A 键(测试用)
                &kp B    // B 键(测试用)
            >;
        };
    };
};